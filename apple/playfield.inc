.align	$100
colors:
	.byte $00
	.byte $00
	.byte $00
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	.byte $00

.align	$100
playfield0_left:
	.byte $00
	.byte $00
	.byte $00
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	.byte $00

.align	$100
playfield1_left:
	.byte $00
	.byte $00
	.byte $00
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	.byte $00

.align	$100
playfield2_left:
	.byte $00
	.byte $00
	.byte $00
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	.byte $00

.align	$100
playfield0_right:
	.byte $00
	.byte $00
	.byte $00
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	.byte $00

.align	$100
playfield1_right:
	.byte $00
	.byte $00
	.byte $00
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	.byte $00

.align	$100
playfield2_right:
	.byte $00
	.byte $00
	.byte $00
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	.byte $00
