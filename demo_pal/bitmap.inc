lady_sprite0:
	.byte $00	; ........
	.byte $00	; ........
	.byte $05	; *.*.....
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	.byte $00	; ........

lady_sprite1:
	.byte $00	; ........
	.byte $5F	; *****.*.
	.byte $2F	; ****.*..
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	.byte $00	; ........

lady_sprite2:
	.byte $00	; ........
	.byte $FF	; ********
	.byte $FF	; ********
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	.byte $00	; ........

lady_sprite3:
	.byte $00	; ........
	.byte $40	; ......*.
	.byte $80	; .......*
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	.byte $00	; ........

lady_sprite4:
	.byte $00	; ........
	.byte $00	; ........
	.byte $00	; ........
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	.byte $00	; ........

lady_sprite5:
	.byte $00	; ........
	.byte $00	; ........
	.byte $00	; ........
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	.byte $00	; ........
