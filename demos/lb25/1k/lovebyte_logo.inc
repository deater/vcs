lovebyte_playfield0_left:
	.byte $00,$00,$00,$00,$00,$00,$00,$00
	.byte $00,$00,$00,$00,$00,$00,$00,$E0
	.byte $E0,$E0,$20,$20,$20,$20,$20,$20
	.byte $20,$A0,$A0,$A0,$A0,$20,$20,$20
	.byte $20,$20,$20,$00,$00,$00,$00,$00
	.byte $00,$00,$00,$00,$00,$00,$00,$00

lovebyte_playfield1_left:
	.byte $00,$00,$00,$00,$00,$00,$00,$00
	.byte $00,$00,$00,$00,$00,$00,$00,$90
	.byte $90,$B8,$38,$3C,$3C,$7C,$7C,$FE
	.byte $FE,$FE,$FF,$FF,$FF,$EF,$EE,$EE
	.byte $EE,$44,$44,$00,$00,$00,$00,$00
	.byte $00,$00,$00,$00,$00,$00,$00,$00

lovebyte_playfield2_left:
	.byte $00,$00,$00,$00,$00,$00,$00,$00
	.byte $00,$00,$00,$00,$00,$00,$00,$E4
	.byte $E4,$E4,$24,$2E,$2A,$2A,$2A,$2A
	.byte $EA,$EA,$EA,$2A,$2A,$2A,$2A,$2A
	.byte $EA,$EA,$EA,$00,$00,$00,$00,$00
	.byte $00,$00,$00,$00,$00,$00,$00,$00

lovebyte_playfield0_right:
	.byte $00,$00,$00,$00,$00,$00,$00,$00
	.byte $00,$00,$00,$00,$00,$00,$00,$D0
	.byte $D0,$D0,$40,$40,$40,$40,$40,$40
	.byte $C0,$C0,$C0,$40,$40,$40,$40,$40
	.byte $D0,$D0,$D0,$00,$00,$00,$00,$00
	.byte $00,$00,$00,$00,$00,$00,$00,$00

.align $100

lovebyte_playfield1_right:
	.byte $00,$00,$00,$00,$00,$00,$00,$00
	.byte $00,$00,$00,$00,$00,$00,$00,$88
	.byte $C8,$C8,$48,$48,$48,$48,$48,$48
	.byte $C8,$DC,$94,$94,$94,$94,$94,$94
	.byte $95,$95,$15,$00,$00,$00,$00,$00
	.byte $00,$00,$00,$00,$00,$00,$00,$00

lovebyte_playfield2_right:
	.byte $00,$00,$00,$00,$00,$00,$00,$00
	.byte $00,$00,$00,$00,$00,$00,$00,$79
	.byte $79,$79,$09,$09,$09,$09,$09,$09
	.byte $39,$39,$39,$09,$09,$09,$09,$09
	.byte $7B,$7B,$7B,$00,$00,$00,$00,$00
	.byte $00,$00,$00,$00,$00,$00,$00,$00
