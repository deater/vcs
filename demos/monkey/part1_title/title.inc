; Using background color $00


top_title_words_bg_colors:
	.byte $A0,$8C,$90,$90,$90,$90
top_title_words_colors:
	.byte $9C,$A0,$0E,$F4,$F4,$00
top_title_words_playfield0_left:
	.byte $00,$E0,$80,$00,$00,$00
top_title_words_playfield1_left:
	.byte $40,$F7,$01,$00,$00,$00
top_title_words_playfield2_left:
	.byte $10,$FF,$00,$80,$40,$F0

bottom_title_words_bg_colors:
	.byte $00,$A0,$00,$A0
	.byte $A0,$A0,$A0,$A0,$A0,$A0,$A0,$A0
bottom_title_words_colors:
	.byte $A0,$00,$A0,$00
	.byte $00,$00,$00,$00,$00,$00,$00,$00
bottom_title_words_playfield0_left:
	.byte $80,$00,$E0,$A0
	.byte $C0,$E0,$80,$00,$00,$00,$00,$00
bottom_title_words_playfield1_left:
	.byte $E0,$7F,$08,$87
	.byte $B3,$DF,$F7,$7F,$47,$04,$02,$00
bottom_title_words_playfield2_left:
	.byte $04,$C7,$55,$6F
	.byte $6D,$53,$ED,$D7,$0F,$BF,$82,$00

title_words_playfield0_left:
	.byte $E0,$40
	.byte $40,$40,$40,$40,$40,$00,$E0,$C0
	.byte $C0,$C0,$C0,$C0,$C0,$C0,$C0,$C0
	.byte $C0,$C0,$C0,$C0,$C0,$C0,$C0,$C0
	.byte $C0,$C0,$40,$00

title_words_playfield1_left:
	.byte $00,$00
	.byte $AC,$A8,$EC,$A8,$AC,$00,$0C,$09
	.byte $89,$9A,$9A,$9A,$FA,$F9,$F9,$F8
	.byte $68,$68,$68,$4B,$49,$09,$09,$09
	.byte $01,$01,$01,$01

title_words_playfield2_left:
	.byte $06,$01
	.byte $B1,$92,$B4,$94,$B3,$00,$77,$65
	.byte $E8,$A8,$A8,$A8,$28,$28,$24,$07
	.byte $80,$98,$84,$85,$84,$8C,$B8,$A0
	.byte $A0,$A0,$34,$1C

title_words_playfield0_right:
	.byte $00,$00
	.byte $D0,$40,$C0,$40,$50,$00,$A0,$A0
	.byte $A0,$A0,$A0,$B0,$B0,$B0,$20,$20
	.byte $00,$00,$00,$00,$00,$80,$80,$80
	.byte $A0,$B0,$00,$00

title_words_playfield1_right:
	.byte $00,$00
	.byte $B7,$A2,$32,$A2,$B2,$00,$2E,$48
	.byte $48,$88,$CC,$48,$48,$68,$2D,$07
	.byte $00,$40,$CC,$CE,$CE,$2A,$2B,$E9
	.byte $29,$29,$28,$00

title_words_playfield2_right:
	.byte $00,$00
	.byte $DC,$54,$D4,$54,$5C,$00,$31,$12
	.byte $1A,$0E,$0E,$04,$04,$04,$04,$04
	.byte $04,$04,$00,$01,$0D,$15,$25,$45
	.byte $45,$45,$45,$45

left_sprite:
	.byte $40,$40,$40,$40,$40,$40,$40,$40,$E0,$00,$00,$00

right_sprite:
	.byte $A2,$A4,$38,$00,$00,$00,$00,$00,$00,$00,$00,$00
