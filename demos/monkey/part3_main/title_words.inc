
sprite0:
	.byte $00
	.byte $71	; .***...*
	.byte $89	; *...*..*
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	.byte $F0	; ****....

sprite1:
	.byte $00
	.byte $04	; .....*..
	.byte $04	; .....*..
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	.byte $00	; ........

.align $100

sprite2:
	.byte $00
	.byte $13	; ...*..**
	.byte $14	; ...*.*..
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	.byte $00	; ........

sprite3:
	.byte $00
	.byte $D3	; **.*..**
	.byte $14	; ...*.*..
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	.byte $00	; ........

sprite4:
	.byte $00
	.byte $CF	; **..****
	.byte $10	; ...*....
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	.byte $00	; ........

sprite5:
	.byte $00	; ........
	.byte $00	; ........
	.byte $00	; ........
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	.byte $00	; ........
