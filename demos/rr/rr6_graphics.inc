; Using background color $06

frame6_playfield2_left:
	.byte $00,$00,$00,$00,$00,$00,$00,$00
	.byte $00,$00,$00,$00,$00,$00,$00,$00
	.byte $00,$00,$00,$00,$00,$00,$00,$00
	.byte $80,$A0,$F8,$FC,$FE,$FE,$FF,$7F
	.byte $7F,$7F,$7F,$7F,$7F,$7F,$7F,$7F
	.byte $7F,$7F,$7F,$7F,$7F,$7F,$7F,$7F

frame6_playfield0_right:
	.byte $00,$00,$00,$00,$00,$00,$00,$00
	.byte $00,$00,$00,$00,$00,$00,$00,$00
	.byte $00,$00,$00,$00,$00,$00,$00,$20
	.byte $70,$F0,$F0,$F0,$F0,$F0,$F0,$F0
	.byte $F0,$F0,$F0,$F0,$F0,$F0,$F0,$F0
	.byte $F0,$F0,$F0,$F0,$F0,$F0,$F0,$F0

frame6_playfield1_right:
	.byte $00,$00,$00,$00,$00,$00,$00,$00
	.byte $00,$00,$00,$00,$00,$00,$00,$00
	.byte $00,$00,$00,$00,$00,$00,$00,$00
	.byte $00,$00,$80,$C0,$E0,$E0,$F0,$F0
	.byte $F0,$F0,$F0,$F0,$F0,$F0,$F0,$F0
	.byte $F0,$F0,$F0,$F0,$F0,$F0,$F0,$F0

;frame6_playfield2_right:
;	.byte $00,$00,$00,$00,$00,$00,$00,$00
;	.byte $00,$00,$00,$00,$00,$00,$00,$00
;	.byte $00,$00,$00,$00,$00,$00,$00,$00
;	.byte $00,$00,$00,$00,$00,$00,$00,$00
;	.byte $00,$00,$00,$00,$00,$00,$00,$00
;	.byte $00,$00,$00,$00,$00,$00,$00,$00


; Using background color $00
frame6_1_overlay_colors:
	.byte $00,$00,$00,$00,$00,$00,$24,$20
	.byte $F2,$F2,$F4,$F4,$F4,$F4,$F4,$36
	.byte $48,$48,$48,$48,$46,$46,$48,$4A
	.byte $4A,$0A,$0A,$0A,$0A,$0A,$0A,$0A
	.byte $0A,$0A,$0A,$0A,$0A,$0A,$0A,$0A
	.byte $0A,$0A,$0A,$0A,$0A,$0A,$0A,$0A


frame6_1_overlay_sprite:
	.byte $00,$00,$00,$00,$00,$00,$18,$30
	.byte $22,$26,$30,$22,$62,$52,$16,$44
	.byte $72,$72,$30,$38,$20,$30,$28,$38
	.byte $20,$44,$44,$44,$44,$64,$00,$68
	.byte $00,$28,$00,$28,$00,$20,$00,$20
	.byte $00,$20,$00,$20,$00,$20,$00,$20

; Using background color $00
frame6_2_overlay_colors:
	.byte $00,$00,$00,$00,$00,$00,$26,$22
	.byte $F0,$F0,$F2,$4A,$4A,$4A,$48,$48
	.byte $4A,$4A,$4A,$4A,$48,$48,$46,$0A
	.byte $0A,$48,$04,$04,$06,$06,$06,$06
	.byte $06,$06,$06,$06,$06,$06,$06,$06
	.byte $4A,$4A,$48,$4A,$48,$48,$4A,$48


frame6_2_overlay_sprite:
	.byte $00,$00,$00,$00,$00,$00,$10,$38
	.byte $70,$60,$38,$70,$70,$B0,$A0,$E0
	.byte $30,$30,$30,$10,$60,$20,$40,$10
	.byte $70,$80,$80,$80,$80,$00,$00,$00
	.byte $00,$00,$00,$00,$00,$00,$00,$00
	.byte $04,$07,$07,$07,$07,$07,$02,$02

