
credits_sprite0:
	.byte $00	; ........
	.byte $00	; ........
	.byte $05	; *.*.....
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	.byte $00	; ........

credits_sprite1:
	.byte $00	; ........
	.byte $00	; ........
	.byte $55	; *.*.*.*.
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	.byte $00	; ........

credits_sprite2:
	.byte $00	; ........
	.byte $00	; ........
	.byte $57	; ***.*.*.
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	.byte $00	; ........

credits_sprite3:
	.byte $00	; ........
	.byte $00	; ........
	.byte $54	; ..*.*.*.
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	.byte $00	; ........

credits_sprite4:
	.byte $00	; ........
	.byte $00	; ........
	.byte $58	; ...**.*.
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	.byte $00	; ........

credits_sprite5:
	.byte $00	; ........
	.byte $00	; ........
	.byte $80	; .......*
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	.byte $00	; ........
