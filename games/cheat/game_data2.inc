
vid_sprite0:
	.byte $00	; ........
	.byte $18	; ...**...
	.byte $24	; ..*..*..
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	.byte $00	; ........
you_win_sprite5:
you_win_sprite0:

	.byte $00	; ........
	.byte $00	; ........
	.byte $00	; ........
	.byte $00	; ........
	.byte $00	; ........
	.byte $00	; ........
	.byte $00	; ........
;	.byte $00	; ........
;	.byte $00	; ........

vid_sprite1:
	.byte $00	; ........
	.byte $00	; ........
	.byte $4E	; .*..***.
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	.byte $01	; .......*
;	.byte $00	; ........
;	.byte $00	; ........

vid_sprite2:
	.byte $00	; ........
	.byte $00	; ........
	.byte $74	; .***.*..
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	.byte $E5	; ***..*.*
;	.byte $00	; ........
;	.byte $00	; ........

vid_sprite3:
	.byte $00	; ........
	.byte $00	; ........
	.byte $E7	; ***..***
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	.byte $DD	; **.***.*
;	.byte $00	; ........
;	.byte $00	; ........

vid_sprite4:
	.byte $00	; ........
	.byte $00	; ........
	.byte $34	; ..**.*..
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	.byte $C0	; **......
;	.byte $00	; ........
;	.byte $00	; ........

vid_sprite5:
	.byte $00	; ........
	.byte $00	; ........
	.byte $29	; ..*.*..*
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	.byte $00	; ........
;	.byte $00	; ........
;	.byte $00	; ........

cheat_title0:
	.byte $0A	; ....*.*.
	.byte $15	; ...*.*.*
	.byte $0A	; ....*.*.
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	.byte $C0	; **......

cheat_title1:
	.byte $FF	; ********
	.byte $FF	; ********
	.byte $DF	; **.*****
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	.byte $00	; ........

cheat_title2:
	.byte $FF	; ********
	.byte $FF	; ********
	.byte $FF	; ********
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	.byte $00	; ........

.align $100

cheat_title3:
	.byte $DD	; **.***.*
	.byte $EF	; ***.****
	.byte $BD	; *.****.*
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	.byte $00	; ........

cheat_title4:
	.byte $BF	; *.******
	.byte $6B	; .**.*.**
	.byte $FF	; ********
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	.byte $00	; ........

cheat_title5:
	.byte $FD	; ******.*
	.byte $FE	; *******.
	.byte $FC	; ******..
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	.byte $00	; ........



; Using background color $72

title_playfield0_left:
	.byte $80,$C0,$E0,$F0,$70,$30,$30,$30
	.byte $30,$30,$30,$B0,$F0,$F0,$70,$00

title_playfield1_left:
	.byte $E0,$C0,$80,$04,$0C,$0C,$0C,$0D
	.byte $0F,$6E,$EC,$CC,$8C,$0C,$0C,$00

title_playfield2_left:
	.byte $00,$86,$C6,$E6,$F6,$76,$37,$B7
	.byte $F6,$76,$36,$B6,$F2,$F0,$70,$00


title_playfield0_right:
	.byte $00,$70,$30,$10,$00,$60,$30,$10
	.byte $00,$60,$70,$30,$10,$00,$00,$00


title_playfield1_right:
	.byte $00,$1E,$3E,$7E,$E6,$C6,$CE,$DE
	.byte $F6,$E6,$C6,$C6,$C4,$C0,$C0,$00

title_playfield2_right:
	.byte $00,$F0,$78,$3C,$1E,$1F,$18,$18
	.byte $18,$18,$18,$18,$18,$18,$08,$00



; 10 bytes wasted
.align $100




; Using background color $72, FG $08

blue_playfield1_left:
	.byte $00,$00,$00,$00,$00,$00,$00,$00
	.byte $00,$00,$00,$38,$7C,$FC,$FE,$FF
	.byte $FF,$FF,$FF,$FF,$F7,$07,$77,$77
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	.byte $00,$00,$00,$00

blue_playfield2_left:
	.byte $00,$00,$00,$00,$09,$0B,$0F,$0F
	.byte $0F,$0F,$0F,$0F,$0E,$06,$03,$03
	.byte $03,$03,$03,$03,$03,$03,$03,$03
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	.byte $00,$00,$00,$00

game_over_playfield0_left:
	.byte $80,$40,$40,$40,$C0,$00

game_over_playfield1_left:
	.byte $92,$2B,$3A,$AA,$AA,$00

game_over_playfield2_left:
	.byte $74,$16,$35,$14,$74,$00

game_over_playfield0_right:
	.byte $00,$80,$80,$80,$00,$00

game_over_playfield1_right:
	.byte $95,$55,$55,$49,$89,$00

game_over_playfield2_right:
	.byte $1B,$28,$19,$28,$2B,$00


cheat_sprite_yellow:
	.byte $00
	.byte $00
	.byte $7D
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	.byte $FC

cheat_sprite_black:
	.byte $00
	.byte $00
	.byte $0A
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	.byte $04

.align $100  ; 14 bytes here

blue_playfield0_right:
	.byte $00,$00,$00,$00,$00,$00,$80,$00
	.byte $00,$00,$00,$00,$00,$00,$00,$00
	.byte $00,$00,$00,$00,$00,$00,$00,$00
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	.byte $20,$20,$20,$20,$20,$20,$20;,$00
;	.byte $00,$00,$00,$00

blue_playfield1_right:
	.byte $00,$00,$00,$00,$00,$E0,$61,$20
	.byte $20,$20,$20,$70,$70,$70,$70,$00
	.byte $A6,$A6,$FF,$FF,$FF,$F6,$6F,$6F
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	.byte $00,$00,$00,$00


;=========================================
; sound effects
; doesn't need to be aligned?

sfx_f:
sfx_start:
	.byte	0, 26	; collide
sfx_collide:
	.byte	0, 12, 12, 12, 12, 12, 12, 12, 12	; zap
sfx_zap:
	.byte	0,22,22,23,23,24,24,25,25,26,26,27,28,29,30,31 ; collect
sfx_collect:
	.byte	0, 0, 0, 1, 1, 2, 2, 3, 3 ; speed
sfx_speed:
;	.byte	0, 8, 8, 8, 8, 8, 8, 8, 8, 8, 8, 8, 8, 8, 8, 8 ; ping
;sfx_ping:
;	.byte	0,26,26,26,26,26,26,26,29,29,29,29,29,29,29 ; game over
;	.byte	0,26,26,26,26,26,26
;sfx_game_over:

sfx_cv:
	.byte	0,$8F	; collide
	.byte	0,$3F,$3F,$3F,$3F,$3F,$3f,$3f,$3f	; zap
	.byte	0,$7f,$7f,$7f,$7f,$7f,$7f,$7f
	.byte	  $7f,$7f,$7f,$7f,$7f,$7f,$7f,$7f ; collect
	.byte	0,$6f,$6f,$6f,$6f,$6f,$6f,$6f,$6f ; speed
;	.byte	0,$41,$42,$43,$44,$45,$46,$47,$48
;	.byte	  $49,$4a,$4b,$4c,$4d,$4e,$4f ; ping
;	.byte	0,$7f,$7f,$7f,$7f,$7f,$7f,$7f
;	.byte	  0,$E0,$E0,$E0,$E0,$E0,$EF ; game over

; F, C/V
; collide V=F, C=8, F=31    (8,26)
; zap =   V=F, C=3, F=12
; collect V=F, C=6, F=2		; not really
; die	  V=F, C=8, F=24
; level over V=G,  7/26 1/29
; click  V=F C=15, F=26
SFX_COLLIDE	=	sfx_collide-sfx_start-1
SFX_ZAP		=	sfx_zap-sfx_start-1
SFX_COLLECT	=	sfx_collect-sfx_start-1
SFX_SPEED	=	sfx_speed-sfx_start-1
;SFX_PING	=	sfx_ping-sfx_start-1
;SFX_CLICK	=	sfx_game_over-sfx_start-1


.align $100

score_bitmap0:  ; turns out this was same pattern
score_zeros:    .byte $22,$55,$55,$55,$55,$55,$22,$00
score_ones:     .byte $22,$66,$22,$22,$22,$22,$77,$00
score_twos:     .byte $22,$55,$11,$22,$44,$44,$77,$00
score_threes:   .byte $22,$55,$11,$22,$11,$55,$22,$00
score_fours:    .byte $55,$55,$55,$77,$11,$11,$11,$00

; --****** ----**-- --****** ----**-- ----**--
; --**---- --**--** ------** --**--** --**--**
; --****-- --**---- ------** --**--** --**--**
; ------** --****-- ----**-- ----**-- ----****
; ------** --**--** --**---- --**--** ------**
; --**--** --**--** --**---- --**--** --**--**
; ----**-- ----**-- --**---- ----**-- ----**--

score_fives:    .byte   $77,$44,$66,$11,$11,$55,$22,$00
score_sixes:    .byte   $33,$44,$44,$66,$55,$55,$22,$00
score_sevens:   .byte   $77,$11,$11,$22,$44,$44,$44,$00
score_eights:   .byte   $22,$55,$55,$22,$55,$55,$22,$00
score_nines:    .byte   $22,$55,$55,$33,$11,$55,$22,$00

blue_playfield2_right:
	.byte $00,$00,$00,$00,$00,$07,$06,$04
	.byte $04,$04,$04,$0E,$0E,$0E,$0E,$00
	.byte $0A,$0A,$0F,$0F,$0F,$0F,$06,$06
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	.byte $00,$00,$00,$00




bearshark_playfield1_left:
	.byte $00,$00,$00,$00,$00,$00,$00,$80
	.byte $C0,$C0,$66,$7F,$7F,$3E,$3E,$3E
	.byte $3C,$31,$31,$31,$31,$31,$21,$21
	.byte $21,$21,$21,$00,$00,$00,$00,$00
	.byte $00,$00,$00,$00,$00,$00,$00,$00
	.byte $00,$00


bearshark_playfield2_left:
	.byte $40,$40,$60,$60,$60,$60,$E0,$F0
	.byte $F0,$F0,$F0,$FF,$FB,$FB,$FD,$FD
	.byte $03,$03,$03,$DB,$EB,$FB,$F3,$DB
	.byte $DB,$3B,$5B,$5B,$47,$57,$A7,$B7
	.byte $AE,$1E,$FC,$FC,$F8,$F8,$F8,$F8
	.byte $00,$00

.align $100

bearshark_playfield0_right:
	.byte $00,$00,$00,$00,$00,$00,$00,$00
	.byte $00,$F0,$F0,$F0,$F0,$F0,$F0,$F0
	.byte $00,$00,$60,$40,$70,$30,$60,$60
	.byte $70,$40,$50,$50,$50,$50,$A0,$A0
	.byte $C0,$E0,$F0,$F0,$F0,$F0,$F0,$F0
;	.byte $00,$00


bearshark_playfield1_right:
	.byte $00,$00,$00,$00,$00,$00,$42,$42
	.byte $24,$DB,$CB,$DF,$F8,$DF,$1F,$00
	.byte $60,$70,$70,$70,$70,$F0,$F0,$F0
	.byte $F0,$F0,$F0,$F0,$F0,$E0,$E0,$E0
	.byte $C0,$80,$80,$80,$80,$80,$80,$80
;	.byte $00,$00

bearshark_playfield2_right:

	.byte $00,$00,$00,$00,$00,$00,$00,$30
	.byte $2F,$2B,$2A,$0A,$15,$15,$1F,$00
	.byte $00,$00,$00,$00,$00,$00,$00,$00
	.byte $00,$00,$00,$00,$00,$00,$00,$00
	.byte $00,$00
cake_graph:

	.byte $00,$00,$00,$00,$00,$00
	.byte $00,$00
	;
        .byte $f0,$f0,$f0,$f0,$f0,$f0,$f0,$f0

you_win_sprite1:
	.byte $00	; ........
	.byte $44	; .*...*..
	.byte $4A	; .*..*.*.
	.byte $EA	; ***.*.*.
	.byte $AA	; *.*.*.*.
	.byte $A4	; *.*..*..
	.byte $00	; ........	; don't remove

you_win_sprite2:
	.byte $00	; ........
	.byte $40	; .*......
	.byte $A0	; *.*.....
	.byte $A0	; *.*.....
	.byte $A0	; *.*.....
	.byte $A0	; *.*.....
	.byte $00	; ........	; don't remove

you_win_sprite3:
	.byte $00	; ........
	.byte $53	; .*.*..**
	.byte $A9	; *.*.*..*
	.byte $89	; *...*..*
	.byte $89	; *...*..*
	.byte $8B	; *...*.**
	.byte $00	; ........	; don't remove

you_win_sprite4:
	.byte $00	; ........
	.byte $A5	; *.*..*.*
	.byte $24	; ..*..*..
	.byte $2D	; ..*.**.*
	.byte $35	; ..**.*.*
	.byte $A5	; *.*..*.*
	.byte $00	; ........


