
pit_playfield1_left:
	;.byte $00,$00,
	.byte $00,$00,$00,$00,$FF,$FF
	.byte $FF,$FF,$FF,$7F,$7F,$3F,$3F,$3F
	.byte $3F,$3F,$3F,$3F,$3F,$1F,$1F,$1F
	.byte $1F,$1F,$1F,$1F,$0F,$0F,$0F,$0F
	.byte $07,$07,$03,$01,$00,$00,$00,$00
	.byte $00,$00,$00,$00,$00,$00,$00,$00

pit_playfield2_left:
	;.byte $00,$00,
	.byte $00,$00,$00,$00,$FF,$FF
	.byte $FF,$FF,$FF,$FF,$FF,$FF,$FF,$FF
	.byte $FF,$FF,$FF,$FF,$FF,$FF,$FF,$FF
	.byte $FF,$FF,$FF,$FF,$FF,$FF,$FF,$FF
	.byte $FF,$FF,$FF,$FF,$FF,$00,$00,$00
	.byte $00,$00,$00,$00,$00,$00,$00,$00

.align $100

avoid_sprite0:
	.byte $00	; ........
	.byte $00	; ........
	.byte $65	; .**..*.*
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	.byte $00	; ........

avoid_sprite1:
	.byte $00	; ........
	.byte $00	; ........
	.byte $74	; .***.*..
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	.byte $00	; ........

avoid_sprite2:
	.byte $00	; ........
	.byte $00	; ........
	.byte $59	; .*.**..*
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	.byte $00	; ........

avoid_sprite3:
	.byte $00	; ........
	.byte $00	; ........
	.byte $D9	; **.**..*
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	.byte $00	; ........

avoid_sprite4:
	.byte $00	; ........
	.byte $00	; ........
	.byte $AA	; *.*.*.*.
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	.byte $00	; ........

avoid_sprite5:
	.byte $00	; ........
	.byte $00	; ........
	.byte $B6	; *.**.**.
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	.byte $00	; ........
