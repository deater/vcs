; Using background color $00

stick_overlay_colors:
	.byte $00
	.byte $00,$22,$22,$22
	.byte $22,$22,$22,$22
	.byte $22,$22,$22,$22
	.byte $22,$22,$22,$22
	.byte $22,$C0,$00,$00

stick_overlay_sprite:
	.byte $00
	.byte $00,$04,$04,$04
	.byte $0C,$04,$04,$04
	.byte $05,$06,$44,$2C
	.byte $2C,$18,$08,$08
	.byte $08,$3E,$00,$00

.if 0
stick_overlay_colors:
	.byte $00,$00,$22,$22,$22,$22,$22,$22
	.byte $22,$22,$22,$22,$22,$22,$22,$22
	.byte $22,$22,$22,$22,$22,$22,$22,$22
	.byte $22,$22,$22,$22,$22,$22,$22,$22
	.byte $22,$22,$C0,$C0,$00,$00,$00,$00

stick_overlay_sprite:
	.byte $00,$00,$04,$04,$04,$04,$04,$04
	.byte $0C,$0C,$04,$04,$04,$04,$04,$04
	.byte $05,$05,$06,$06,$44,$44,$2C,$2C
	.byte $2C,$2C,$18,$18,$08,$08,$08,$08
	.byte $08,$08,$3E,$3E,$00,$00,$00,$00

.endif
