; Using background color $72

title_playfield0_left:
	.byte $80,$C0,$E0,$F0,$70,$30,$30,$30
	.byte $30,$30,$30,$B0,$F0,$F0,$70,$00

title_playfield1_left:
	.byte $E0,$C0,$80,$04,$0C,$0C,$0C,$0D
	.byte $0F,$6E,$EC,$CC,$8C,$0C,$0C,$00

title_playfield2_left:
	.byte $00,$86,$C6,$E6,$F6,$76,$37,$B7
	.byte $F6,$76,$36,$B6,$F2,$F0,$70,$00


title_playfield0_right:
	.byte $00,$70,$30,$10,$00,$60,$30,$10
	.byte $00,$60,$70,$30,$10,$00,$00,$00


title_playfield1_right:
	.byte $00,$1E,$3E,$7E,$E6,$C6,$CE,$DE
	.byte $F6,$E6,$C6,$C6,$C4,$C0,$C0,$00

title_playfield2_right:
	.byte $00,$F0,$78,$3C,$1E,$1F,$18,$18
	.byte $18,$18,$18,$18,$18,$18,$08,$00




