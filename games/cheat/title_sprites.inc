
vid_sprite0:
	.byte $00	; ........
	.byte $18	; ...**...
	.byte $24	; ..*..*..
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	.byte $00	; ........
;	.byte $00	; ........
;	.byte $00	; ........

vid_sprite1:
	.byte $00	; ........
	.byte $00	; ........
	.byte $4E	; .*..***.
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	.byte $01	; .......*
;	.byte $00	; ........
;	.byte $00	; ........

vid_sprite2:
	.byte $00	; ........
	.byte $00	; ........
	.byte $74	; .***.*..
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	.byte $E5	; ***..*.*
;	.byte $00	; ........
;	.byte $00	; ........

vid_sprite3:
	.byte $00	; ........
	.byte $00	; ........
	.byte $E7	; ***..***
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	.byte $DD	; **.***.*
;	.byte $00	; ........
;	.byte $00	; ........

vid_sprite4:
	.byte $00	; ........
	.byte $00	; ........
	.byte $34	; ..**.*..
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	.byte $C0	; **......
;	.byte $00	; ........
;	.byte $00	; ........

vid_sprite5:
	.byte $00	; ........
	.byte $00	; ........
	.byte $29	; ..*.*..*
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	.byte $00	; ........
;	.byte $00	; ........
;	.byte $00	; ........

.align $100

cheat_title0:
	.byte $0A	; ....*.*.
	.byte $15	; ...*.*.*
	.byte $0A	; ....*.*.
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	.byte $C0	; **......

cheat_title1:
	.byte $FF	; ********
	.byte $FF	; ********
	.byte $DF	; **.*****
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	.byte $00	; ........

cheat_title2:
	.byte $FF	; ********
	.byte $FF	; ********
	.byte $FF	; ********
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	.byte $00	; ........

cheat_title3:
	.byte $DD	; **.***.*
	.byte $EF	; ***.****
	.byte $BD	; *.****.*
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	.byte $00	; ........

cheat_title4:
	.byte $BF	; *.******
	.byte $6B	; .**.*.**
	.byte $FF	; ********
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	.byte $00	; ........

.align $100

cheat_title5:
	.byte $FD	; ******.*
	.byte $FE	; *******.
	.byte $FC	; ******..
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	.byte $00	; ........
