falling_sprite:
	.byte	$E0,$31,$1A,$1E,$FE,$1E,$0F,$05;,$00

cleft_colors:
	.byte $00,$00,$00,$00,$00, $02,$02,$02
	.byte $02,$02,$02,$04,$A4,$A4,$A4,$A4
	.byte $A4,$A6,$A6,$A8,$A8,$AC,$AE,$AE
	.byte $AE,$AC,$AC,$AA,$A8,$A6,$A6,$A4
	.byte $A4,$A4,$A4,$A4,$04,$04,$02,$02
	.byte $02,$02, $00,$00,$00,$00,$00,$00

cleft_playfield2_left:
;	.byte $00
;	.byte $00
;	.byte $00
;	.byte $00
;	.byte $00

	.byte $80
	.byte $80
	.byte $80
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	.byte $00

;	.byte $00
;	.byte $00
;	.byte $00
;	.byte $00
;	.byte $00
;	.byte $00

cleft_playfield0_right:
;	.byte $00
;	.byte $00
;	.byte $00
;	.byte $00
;	.byte $00

	.byte $00
	.byte $00
	.byte $00
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	.byte $10

;	.byte $00
;	.byte $00
;	.byte $00
;	.byte $00
;	.byte $00
;	.byte $00


