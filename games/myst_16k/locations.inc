; Marker switches have to be 0...7 for code size reasons
LOCATION_GEAR_N		=	0
LOCATION_DENTIST_N	=	1
LOCATION_ROCKET_CLOSE_N	=	2
LOCATION_POOL_N		=	3
LOCATION_SHACK_W	=	4
LOCATION_CABIN_E	=	5
LOCATION_CLOCK_CLOSE_S	=	6
LOCATION_DOCK_N		=	7

; places you can grab
;  first few are special as they are also link book locations/destinations
;	don't mess with them as the book code uses that knowledge
LOCATION_RED_BOOK_CLOSE	=	8	; red book
LOCATION_BLUE_BOOK_CLOSE=	9	; blue book
LOCATION_BEHIND_FIREPLACE=	10	; green book
LOCATION_ARRIVAL_N	=	11	; star void book
LOCATION_ATRUS_E	=	12	; atrus book


; other places you can grab
LOCATION_LIBRARY_SW	=	13	; tower rotation
LOCATION_INSIDE_FIREPLACE=	14
LOCATION_CLOCK_S	=	15	; go to clock puzzle
LOCATION_LIBRARY_NW	=	16	; library close door
LOCATION_LIBRARY_NE	=	17	; library open door
LOCATION_CLOCK_PUZZLE	=	18	; clock puzzle
LOCATION_IN_ELEVATOR	=	19	; TODO

LOCATION_LIBRARY_N	=	20
LOCATION_ROCKET_N	=	21
LOCATION_HILLTOP_W	=	22
LOCATION_IMAGER_W	=	23
LOCATION_HILLTOP_S	=	24
LOCATION_HILLTOP_N	=	25
LOCATION_HILLTOP_E	=	26
LOCATION_ARRIVAL_E	=	27
LOCATION_CLOCK_N	=	28

LOCATION_SHORTSTEPS_W	=	29
LOCATION_GEAR_S		=	30
LOCATION_LIBRARY_S	=	31
LOCATION_ARRIVAL_S	=	32
LOCATION_ARRIVAL_W	=	33
LOCATION_HILL_W		=	34

LOCATION_LIBRARY_W	=	35
LOCATION_LIBRARY_E	=	36
LOCATION_STEPS_S	=	37
LOCATION_SHACK_S	=	38
LOCATION_CABIN_PATH_S	=	39
LOCATION_CABIN_PATH_N	=	40
LOCATION_LIBRARY_SE	=	41
LOCATION_BURNT_BOOK	=	42
LOCATION_IMAGER_E	=	43
LOCATION_SHACK_N	=	44
LOCATION_DNI_N		=	45
LOCATION_DNI_E		=	46
LOCATION_TRAPPED	=	47
LOCATION_DOCK_S		=	48
LOCATION_DENTIST_E	=	49
LOCATION_ROCKET_S	=	50
LOCATION_POOL_S		=	51
LOCATION_YOU_WIN	=	52

LOCATION_STEPS_E	=	53
LOCATION_LIBRARY_UP	=	54
LOCATION_ELEVATOR_N	=	55
LOCATION_ELEVATOR_S	=	56
LOCATION_HINT		=	57
