; zero page addresses

TITLE_COLOR	=	$80

POINTER_ON	=	$81
POINTER_X	=	$82
POINTER_Y	=	$83
POINTER_X_END	=	$84
POINTER_Y_END	=	$85
			;
SFX_PTR		=	$87
FALL_COUNT	=	$88
BARRIER_STATUS	=	$89
	BARRIER_LIBRARY_DOOR_CLOSED	= $80
	BARRIER_CLOCK_BRIDGE_UP		= $40
			;
CURRENT_LOCATION=	$8B
SWITCH_STATUS	=	$8C
WHICH_BOOK	=	$8D
LINK_DESTINATION=	$8E
			;

TEMP1		=	$90
TEMP2		=	$91
FRAME		=	$92
CURRENT_SCANLINE=	$93
LEVEL		=	$94
INPUT_COUNTDOWN	=	$95
POINTER_TYPE	=	$96
	POINTER_TYPE_POINT	= $00
	POINTER_TYPE_LEFT	= $01
	POINTER_TYPE_RIGHT	= $02
	POINTER_TYPE_GRAB	= $03
	POINTER_TYPE_PAGE	= $04
POINTER_COLOR	=	$97
	POINTER_COLOR_DEFAULT	= $00
	POINTER_COLOR_WHITE	= $0E
	POINTER_COLOR_PINK	= $3C	; 30*2 = 60
	POINTER_COLOR_BLUE	= $AE	; 87*2 = 174
POINTER_GRABBING =	$98

RED_PAGE_COUNT	=	$99
BLUE_PAGE_COUNT	=	$9A
WHITE_PAGE_COUNT=	$9B

OUTL		=	$9C
OUTH		=	$9D
INL		=	$9E
INH		=	$9F


; hold the current level data

LEVEL_DATA	=	LEVEL_HAND_COLOR

LEVEL_HAND_COLOR	=	$A0	; color of sprite 0 (hand)
LEVEL_BACKGROUND_COLOR	=	$A1	; background color
LEVEL_BACKGROUND_COLOR2	=	$A2	; background color 2 (if mid-screen switch)
LEVEL_OVERLAY_X		=	$A3	; X location of overlay sprite
LEVEL_CENTER_DEST	=	$A4
LEVEL_LEFT_DEST		=	$A5
LEVEL_RIGHT_DEST	=	$A6
LEVEL_GRAB_MINX		=	$A7	; XMIN of grab area
LEVEL_GRAB_MAXX		=	$A8	; XMAX of grab area
LEVEL_GRAB_MINY		=	$A9	; YMIN of grab area
LEVEL_GRAB_MAXY		=	$AA	; YMAX of grab area
LEVEL_MISSILE0_X	=	$AB	; X location of missile0 (vertical line)
LEVEL_CENTER_PATCH_COND	=	$AC
LEVEL_CENTER_PATCH_DEST	=	$AD
LEVEL_OVERLAY_PATCH_TYPE=	$AE
LEVEL_RESERVED4		=	$AF

; PATCH LEN
; PATCH LOCATION
; PATCH_VALUE

; also: ALT-DEST


; for the zx02 decompression

offset		=	$B0
offset_h	=	$B1
ZX0_src		=	$B2
ZX0_src_h	=	$B3
ZX0_dst		=	$B4
ZX0_dst_h	=	$B5
bitr		=	$B6
pntr		=	$B7
pntr_h		=	$B8
READ_WRITE_OFFSET=	$B9


FIREPLACE_ROW1  =	$BA
FIREPLACE_ROW2  =	$BB
FIREPLACE_ROW3  =	$BC
FIREPLACE_ROW4  =	$BD
FIREPLACE_ROW5  =	$BE
FIREPLACE_ROW6  =	$BF
EXIT_PUZZLE	=	$C0	; must follow ROW6 for clearing purposes

FIREPLACE_C0_R0	=	$C1
FIREPLACE_C1_R0	=	$C2
FIREPLACE_C2_R0	=	$C3
FIREPLACE_C3_R0	=	$C4
FIREPLACE_C4_R0	=	$C5

FIREPLACE_CHANGED=	$C6
SAVED_ROW	=	$C7

CLOCK_HOURS	=	$C8
CLOCK_MINUTES	=	$C9

CLOCKFACE_0	=	$D0
CLOCKFACE_1	=	$D1
CLOCKFACE_2	=	$D2
CLOCKFACE_3	=	$D3
CLOCKFACE_4	=	$D4
CLOCKFACE_5	=	$D5
CLOCKFACE_6	=	$D6
CLOCKFACE_7	=	$D7
CLOCKFACE_8	=	$D8
CLOCKFACE_9	=	$D9


WAS_CLICKED	=	$DD
FIREPLACE_CORRECT=	$DE
CLOCK_CORRECT	=	$DF

HAND_SPRITE	=	HAND_SPRITE_LINE0
HAND_SPRITE_LINE0=	$E0
HAND_SPRITE_LINE1=	$E1
HAND_SPRITE_LINE2=	$E2
HAND_SPRITE_LINE3=	$E3
HAND_SPRITE_LINE4=	$E4
HAND_SPRITE_LINE5=	$E5
HAND_SPRITE_LINE6=	$E6
HAND_SPRITE_LINE7=	$E7
HAND_SPRITE_LINE8=	$E8
HAND_SPRITE_LINE9=	$E9
HAND_SPRITE_LINE10=	$EA
HAND_SPRITE_LINE11=	$EB
HAND_SPRITE_LINE12=	$EC
HAND_SPRITE_LINE13=	$ED
HAND_SPRITE_LINE14=	$EE
HAND_SPRITE_LINE15=	$EF


; misc helpers

POS_SPRITE0	=	0
POS_SPRITE1	=	1
POS_MISSILE0	=	2
POS_MISSILE1	=	3
POS_BALL	=	4

; need to manually change if mess with sounds
SFX_RUMBLE	=	$2
SFX_CLICK	=	$5
SFX_LINK	=	$22

