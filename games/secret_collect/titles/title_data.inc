;===================
; videlectrix logo

; note, this goes backwards from bottom to top

.align $100

title_bitmap0:
prod_bitmap0:	.byte	$84,$84,$E4,$97,$E0,$00,$00,$00,$00
vmw_bitmap0:	.byte	$00,$00,$00,$00,$00,$00,$00,$00
		.byte	$00,$00,$00,$00,$00,$00,$00,$00
		.byte	$00,$00,$00
and_bitmap0:	.byte	$00,$00,$00,$00,$00,$00,$00,$00
		.byte	$00,$00,$00,$00,$00
vid_bitmap0:	.byte	$18,$24,$24,$5A,$DB,$A5,$42,$C3

title_bitmap1:
prod_bitmap1:	.byte	$18,$25,$A4,$18,$00,$00,$00,$00,$00
vmw_bitmap1:	.byte	$00,$00,$00,$00,$00,$01,$01,$01
		.byte	$00,$00,$00,$00,$00,$00,$00,$00
		.byte	$00,$00,$00
and_bitmap1:	.byte	$00,$00,$00,$00,$00,$00,$00,$00
		.byte	$00,$00,$00,$00,$00
vid_bitmap1:	.byte	$00,$4e,$52,$4e,$02,$42,$80,$80

title_bitmap2:
prod_bitmap2:	.byte	$E6,$29,$E9,$29,$20,$00,$00,$00,$00
vmw_bitmap2:	.byte	$3F,$51,$51,$8A,$8A,$04,$04,$FF
		.byte	$00,$00,$00,$00,$00,$00,$00,$00
		.byte	$00,$00,$00
and_bitmap2:	.byte	$3a,$4a,$5b,$2a,$00,$00,$00,$00
		.byte	$00,$00,$00,$00,$00
vid_bitmap2:	.byte	$00,$74,$a5,$95,$74,$04,$00,$00


title_bitmap3:
prod_bitmap3:	.byte	$39,$42,$42,$37,$02,$00,$00,$00,$00
vmw_bitmap3:	.byte	$FE,$45,$45,$28,$28,$10,$10,$FF
		.byte	$00,$00,$00,$00,$00,$00,$00,$00
		.byte	$00,$00,$00
and_bitmap3:	.byte	$4E,$52,$8E,$02,$02,$00,$00,$00
		.byte	$00,$00,$00,$00,$00
vid_bitmap3:	.byte	$00,$e7,$48,$28,$e6,$00,$00,$00

title_bitmap4:
prod_bitmap4:	.byte	$4C,$52,$52,$0C,$40,$00,$00,$00,$00
vmw_bitmap4:	.byte	$00,$00,$00,$80,$80,$40,$40,$C0
		.byte	$00,$00,$00,$00,$00,$00,$00,$00
		.byte	$00,$00,$00
and_bitmap4:	.byte	$00,$00,$00,$00,$00,$00,$00,$00
		.byte	$00,$00,$00,$00,$00
vid_bitmap4:	.byte	$00,$34,$44,$44,$f7,$40,$00,$00

.align	$100

title_bitmap5:
prod_bitmap5:	.byte	$96,$91,$92,$E4,$03,$00,$00,$00,$00
vmw_bitmap5:	.byte	$00,$00,$00,$00,$00,$00,$00,$00
		.byte	$00,$00,$00,$00,$00,$00,$00,$00
		.byte	$00,$00,$00
and_bitmap5:	.byte	$00,$00,$00,$00,$00,$00,$00,$00
		.byte	$00,$00,$00,$00,$00
vid_bitmap5:	.byte	$00,$29,$26,$A6,$09,$20,$00,$00


