playfield1_left:
	.byte $00
	.byte $01
	.byte $03
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	.byte $00
.if 0
	.byte $00
	.byte $00
	.byte $00
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	.byte $00
.endif

playfield2_left:
	.byte $00
	.byte $8D
	.byte $8D
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	.byte $00
.if 0
	.byte $00
	.byte $00
	.byte $00
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	.byte $00
.endif

.align	$100

playfield0_right:
	.byte $00
	.byte $40
	.byte $50
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	.byte $00
.if 0
	.byte $00
	.byte $00
	.byte $00
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	.byte $00
.endif

playfield1_right:
	.byte $00
	.byte $3E
	.byte $3E
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	.byte $00
.if 0
	.byte $00
	.byte $00
	.byte $00
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	.byte $00
.endif

playfield2_right:
	.byte $00
	.byte $00
	.byte $00
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	.byte $00
.if 0
	.byte $00
	.byte $00
	.byte $00
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	.byte $00
.endif
