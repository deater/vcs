runner_data:

MAX_RUNNER_STATE=16

; for all states: goes left
; for state 5: goes up+left
; for state 6: goes up+down
; for state 7: goes down
; second state 7 stops
; state 8 videlectrix logo appears

; so Ypos = 100, but then 
;         99 98 97 96   95 94  94 95 96 97 98 88

runner_state:
	.byte 9,0,3,4,1,2,3,4,0,3,4,1,5,6,7,7,8,$FF

runner_left:
	.byte <runner0L,<runner0L,<runner0L,<runner0L	; 0,1,2,3
	.byte <runner0L,<runner0L,<runner0L,<runner7L	; 4,5,6,7
	.byte <runner7L,<runner0L			; 8,9

runner_right:
	.byte <runner0,<runner1,<runner2,<runner3	; 0,1,2,3
	.byte <runner4,<runner5,<runner6,<runner7	; 4,5,6,7
	.byte <runner8,<runner0L			; 8,9

runner0L:
	.byte	$00	; ........
	.byte	$00	; ........
	.byte	$00	; ........
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	.byte	$00	; ........

runner0:
	.byte	$00	; ........	; 0
	.byte	$00	; ........	; 1
	.byte	$61	; .XX....X	; 2
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	.byte	$18	; ...XX...	; 17

runner1:
	.byte	$00	; ........
	.byte	$00	; ........
	.byte	$00	; ........
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	.byte	$18	; ...XX...

runner2:
	.byte	$00	; ........
	.byte	$00	; ........
	.byte	$42	; .X....X.
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	.byte	$18	; ...XX...

runner3:
	.byte	$30	; ..XX....
	.byte	$10	; ...X....
	.byte	$14	; ...X.X..
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	.byte	$18	; ...XX...

runner4:
	.byte	$00	; ........
	.byte	$06	; .....XX.
	.byte	$22	; ..X...X.
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	.byte	$18	; ...XX...

runner5:
	.byte	$00	; ........
	.byte	$00	; ........
	.byte	$00	; ........
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	.byte	$00	; ........

runner6:
	.byte	$00	; ........
	.byte	$00	; ........
	.byte	$00	; ........
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	.byte	$00	; ........

runner7L:
	.byte	$00	; ........ ........
	.byte	$00	; ........ ........
	.byte	$00	; ........ ........
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	.byte	$00	; ........ ........

runner7:
	.byte	$00	; ........ ........
	.byte	$00	; ........ ........
	.byte	$00	; ........ ........
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	.byte	$00	; ........ ........


runner8:
	.byte	$00	; ........ ........
	.byte	$00	; ........ ........
	.byte	$00	; ........ ........
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	.byte	$00	; ........ ........
