.align $100

snake_sprite0:
	.byte $00	; ........
	.byte $00	; ........
	.byte $00	; ........
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	.byte $00	; ........

snake_sprite1:
	.byte $38	; ..***...
	.byte $38	; ..***...
	.byte $38	; ..***...
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	.byte $07	; .....***

snake_sprite2:
	.byte $00	; ........
	.byte $00	; ........
	.byte $00	; ........
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	.byte $FF	; ********

.align $100

snake_sprite3:
	.byte $00	; ........
	.byte $00	; ........
	.byte $00	; ........
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	.byte $FC	; ******..

snake_sprite4:
	.byte $70	; .***....
	.byte $70	; .***....
	.byte $70	; .***....
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	.byte $00	; ........

snake_sprite5:
	.byte $00	; ........
	.byte $00	; ........
	.byte $00	; ........
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	.byte $00	; ........
