; Using background color $00

left_colors:
	.byte $00,$9A,$9A,$9A,$AC,$AE,$0E,$EE
        .byte $2C,$1C,$0E,$0E,$0E,$00,$00,$0E
        .byte $EE,$1C,$2C,$28,$0E,$0E,$AE,$AC
        .byte $9A,$00,$00,$00,$40,$D8,$D8,$D8
        .byte $D8,$C0,$D8,$D8,$D4,$D8,$D8,$D8
        .byte $1E,$D8,$D8,$D8,$1E,$1E,$1E,$1E


right_colors:
	.byte $00,$9A,$9A,$D8,$D8,$D8,$D8,$D8
	.byte $D8,$D8,$D8,$DC,$DC,$DC,$DC,$DC
	.byte $DC,$EE,$0E,$0E,$0E,$0E,$0E,$0E
	.byte $40,$40,$40,$40,$40,$D8,$D8,$D8
	.byte $D8,$C0,$D8,$D8,$D4,$D8,$D8,$D8
	.byte $1E,$D8,$D8,$D8,$1E,$1E,$1E,$1E


playfield0_left:
	.byte $00,$00,$00,$00,$80,$80,$C0,$80
	.byte $80,$00,$00,$80,$80,$00,$00,$C0
	.byte $C0,$C0,$C0,$C0,$80,$80,$80,$80
	.byte $80,$00,$00,$00,$00,$00,$00,$00
	.byte $00,$00,$00,$00,$00,$00,$00,$00
	.byte $00,$00,$00,$00,$00,$00,$00,$00

playfield1_left:
	.byte $00,$40,$60,$E5,$ED,$EF,$CF,$8F
	.byte $8B,$C9,$CD,$84,$00,$00,$00,$C7
	.byte $E7,$EF,$EF,$AF,$A9,$C9,$EF,$66
	.byte $C0,$00,$00,$00,$00,$00,$00,$00
	.byte $00,$00,$00,$00,$00,$00,$00,$00
	.byte $00,$00,$00,$00,$00,$00,$00,$00

playfield2_left:
	.byte $00,$00,$00,$6C,$6E,$EE,$EE,$EE
	.byte $EA,$AE,$2A,$09,$00,$00,$00,$14
	.byte $D4,$B6,$BF,$BD,$89,$9D,$9C,$94
	.byte $00,$00,$00,$00,$C0,$E0,$F0,$B8
	.byte $B8,$D8,$F0,$90,$E8,$58,$D8,$70
	.byte $F0,$E0,$C0,$C0,$C0,$E0,$E0,$E0

.align $100

playfield0_right:
	.byte $00,$00,$00,$D0,$D0,$D0,$D0,$D0
	.byte $C0,$D0,$D0,$00,$00,$00,$00,$B0
	.byte $B0,$B0,$B0,$90,$B0,$10,$10,$30
	.byte $00,$00,$00,$00,$30,$70,$E0,$F0
	.byte $F0,$E0,$F0,$F0,$E0,$50,$20,$E0
	.byte $F0,$F0,$F0,$F0,$70,$70,$70,$70



playfield1_right:
	.byte $00,$00,$00,$C1,$81,$81,$81,$03
	.byte $83,$03,$83,$03,$07,$07,$00,$E0
	.byte $E0,$F0,$F0,$A0,$C0,$E1,$A3,$A7
	.byte $07,$0E,$1E,$38,$80,$00,$00,$C0
	.byte $C0,$40,$C0,$C0,$C0,$40,$C0,$C0
	.byte $80,$80,$80,$00,$00,$00,$00,$00

playfield2_right:
	.byte $00,$00,$00,$1F,$1F,$1F,$01,$00
	.byte $04,$06,$07,$07,$06,$06,$06,$06
	.byte $06,$07,$07,$07,$03,$03,$03,$03
	.byte $00,$00,$00,$00,$00,$00,$00,$00
	.byte $00,$00,$00,$00,$00,$00,$00,$00
	.byte $00,$00,$00,$00,$00,$00,$00,$00
