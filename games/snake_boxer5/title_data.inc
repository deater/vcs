runner_data:

MAX_RUNNER_STATE=16

; for all states: goes left
; for state 5: goes up+left
; for state 6: goes up+down
; for state 7: goes down
; second state 7 stops
; state 8 videlectrix logo appears

; so Ypos = 100, but then 
;         99 98 97 96   95 94  94 95 96 97 98 88

runner_state:
	.byte 9,0,3,4,1,2,3,4,0,3,4,1,5,6,7,7,8,$FF

runner_left:
	.byte <runner0L,<runner0L,<runner0L,<runner0L	; 0,1,2,3
	.byte <runner0L,<runner0L,<runner0L,<runner7L	; 4,5,6,7
	.byte <runner7L,<runner0L			; 8,9

runner_right:
	.byte <runner0,<runner1,<runner2,<runner3	; 0,1,2,3
	.byte <runner4,<runner5,<runner6,<runner7	; 4,5,6,7
	.byte <runner8,<runner0L			; 8,9

runner0L:
	.byte	$00	; ........
	.byte	$00	; ........
	.byte	$00	; ........
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	.byte	$00	; ........

runner0:
	.byte	$00	; ........	; 0
	.byte	$00	; ........	; 1
	.byte	$61	; .XX....X	; 2
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	.byte	$18	; ...XX...	; 17

runner1:
	.byte	$00	; ........
	.byte	$00	; ........
	.byte	$00	; ........
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	.byte	$18	; ...XX...

runner2:
	.byte	$00	; ........
	.byte	$00	; ........
	.byte	$42	; .X....X.
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	.byte	$18	; ...XX...

runner3:
	.byte	$30	; ..XX....
	.byte	$10	; ...X....
	.byte	$14	; ...X.X..
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	.byte	$18	; ...XX...

runner4:
	.byte	$00	; ........
	.byte	$06	; .....XX.
	.byte	$22	; ..X...X.
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	.byte	$18	; ...XX...

runner5:
	.byte	$00	; ........
	.byte	$00	; ........
	.byte	$00	; ........
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	.byte	$00	; ........

runner6:
	.byte	$00	; ........
	.byte	$00	; ........
	.byte	$00	; ........
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	.byte	$00	; ........

runner7L:
	.byte	$00	; ........ ........
	.byte	$00	; ........ ........
	.byte	$00	; ........ ........
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	.byte	$00	; ........ ........

runner7:
	.byte	$00	; ........ ........
	.byte	$00	; ........ ........
	.byte	$00	; ........ ........
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	.byte	$00	; ........ ........


runner8:
	.byte	$00	; ........ ........
	.byte	$00	; ........ ........
	.byte	$00	; ........ ........
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	.byte	$00	; ........ ........


.align $100

snake_sprite0:
	.byte $00	; ........
	.byte $00	; ........
	.byte $00	; ........
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	.byte $00	; ........

snake_sprite1:
	.byte $38	; ..***...
	.byte $38	; ..***...
	.byte $38	; ..***...
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	.byte $07	; .....***

snake_sprite2:
	.byte $00	; ........
	.byte $00	; ........
	.byte $00	; ........
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	.byte $FF	; ********

.align $100

snake_sprite3:
	.byte $00	; ........
	.byte $00	; ........
	.byte $00	; ........
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	.byte $FC	; ******..

snake_sprite4:
	.byte $70	; .***....
	.byte $70	; .***....
	.byte $70	; .***....
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	.byte $00	; ........

snake_sprite5:
	.byte $00	; ........
	.byte $00	; ........
	.byte $00	; ........
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	.byte $00	; ........
; Using background color $00

.align $100

left_colors:
	.byte $00,$9A,$9A,$9A,$AC,$AE,$0E,$EE
	.byte $2C,$1C,$0E,$0E,$0E,$00,$00,$0E
	.byte $EE,$1C,$2C,$28,$0E,$0E,$AE,$AC
	.byte $9A,$40,$40,$40

;	.byte $40,$D8,$D8,$D8
;	.byte $D8,$C0,$D8,$D8,$D4,$D8,$D8,$D8
;	.byte $1E,$D8,$D8,$D8,$1E,$1E,$1E,$1E


right_colors:
	.byte $00,$9A,$9A,$D8,$D8,$D8,$D8,$D8
	.byte $D8,$D8,$D8,$DC,$DC,$DC,$DC,$DC
	.byte $DC,$EE,$0E,$0E,$0E,$0E,$0E,$0E
	.byte $40,$40,$40,$40

;	.byte $40,$D8,$D8,$D8
;	.byte $D8,$C0,$D8,$D8,$D4,$D8,$D8,$D8
;	.byte $1E,$D8,$D8,$D8,$1E,$1E,$1E,$1E

.align $100

playfield0_left:
	.byte $00,$00,$00,$00,$80,$80,$C0,$80
	.byte $80,$00,$00,$80,$80,$00,$00,$C0
	.byte $C0,$C0,$C0,$C0,$80,$80,$80,$80
	.byte $80,$00,$00,$00

;	.byte $00,$00,$00,$00
;	.byte $00,$00,$00,$00,$00,$00,$00,$00
;	.byte $00,$00,$00,$00,$00,$00,$00,$00

playfield1_left:
	.byte $00,$40,$60,$E5,$ED,$EF,$CF,$8F
	.byte $8B,$C9,$CD,$84,$00,$00,$00,$C7
	.byte $E7,$EF,$EF,$AF,$A9,$C9,$EF,$66
	.byte $C0,$00,$00,$00

;	.byte $00,$00,$00,$00
;	.byte $00,$00,$00,$00,$00,$00,$00,$00
;	.byte $00,$00,$00,$00,$00,$00,$00,$00

playfield2_left:
	.byte $00,$00,$00,$6C,$6E,$EE,$EE,$EE
	.byte $EA,$AE,$2A,$09,$00,$00,$00,$14
	.byte $D4,$B6,$BF,$BD,$89,$9D,$9C,$94
	.byte $00,$00,$00,$00
;	.byte $C0,$E0,$F0,$B8
;	.byte $B8,$D8,$F0,$90,$E8,$58,$D8,$70
;	.byte $F0,$E0,$C0,$C0,$C0,$E0,$E0,$E0

playfield0_right:
	.byte $00,$00,$00,$D0,$D0,$D0,$D0,$D0
	.byte $C0,$D0,$D0,$00,$00,$00,$00,$B0
	.byte $B0,$B0,$B0,$90,$B0,$10,$10,$30
	.byte $00,$00,$00,$00

;	.byte $30,$70,$E0,$F0
;	.byte $F0,$E0,$F0,$F0,$E0,$50,$20,$E0
;	.byte $F0,$F0,$F0,$F0,$70,$70,$70,$70



playfield1_right:
	.byte $00,$00,$00,$C1,$81,$81,$81,$03
	.byte $83,$03,$83,$03,$07,$07,$00,$E0
	.byte $E0,$F0,$F0,$A0,$C0,$E1,$A3,$A7
	.byte $07,$0E,$1E,$38

;	.byte $80,$00,$00,$C0
;	.byte $C0,$40,$C0,$C0,$C0,$40,$C0,$C0
;	.byte $80,$80,$80,$00,$00,$00,$00,$00

playfield2_right:
	.byte $00,$00,$00,$1F,$1F,$1F,$01,$00
	.byte $04,$06,$07,$07,$06,$06,$06,$06
	.byte $06,$07,$07,$07,$03,$03,$03,$03
	.byte $00,$00,$00,$00
;	.byte $00,$00,$00,$00
;	.byte $00,$00,$00,$00,$00,$00,$00,$00
;	.byte $00,$00,$00,$00,$00,$00,$00,$00
; Using background color $00
;snake_pf_colors:
;	.byte $40,$00,$00,$00
;	.byte $40,$00,$00,$00,$00,$40,$40,$40
;	.byte $1E,$1E,$1E,$1E,$1E,$1E,$1E,$1E

	; 0 1 2 3 4 5 6 7 | 7 6 5 4 3 2 1 0

snake_pf2_left:
	.byte $00
	.byte $E0,$E0,$E0,$E0	; wide bottom
	.byte $E0,$E0,$E0,$E0
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	.byte $00,$00,$00,$00
;	.byte $FF,$FF,$FF,$FF
;	.byte $08,$08,$08,$08	; drip off fangs

.align $100

; Main part of videlectrix logo

; Using background color $00

vplayfield0_left:
	.byte $80,$80,$80,$80;,$00,$00,$00,$00

vplayfield0_right:
	.byte $00,$00,$00,$00,$B0,$A0,$90;,$B0

vplayfield1_left:
	.byte $B0,$B0,$B4,$E0,$E5,$E5,$45,$45

vplayfield2_left:
	.byte $00,$42,$42,$42,$5B,$52,$4A,$5B

vplayfield1_right:
	.byte $00,$10,$10,$10,$BA,$13,$12,$92

vplayfield2_right:
	.byte $00,$00,$02,$00,$2A,$12,$12,$2A
