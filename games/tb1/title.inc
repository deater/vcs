
title0_left:
	.byte $00,$60,$60,$20,$20,$20,$20,$20
	.byte $20,$20,$20,$00,$00,$00,$00,$00
	.byte $00,$00,$00,$00,$00,$00,$00,$00
	.byte $00,$00,$00,$00,$00,$00,$00,$00
	.byte $00,$00,$00,$00,$00,$00,$00,$00
	.byte $00,$00,$00,$00,$00,$00,$00,$00

title1_left:
	.byte $00,$E8,$E8,$AD,$AD,$AA,$AA,$A8
	.byte $A8,$E8,$E8,$00,$00,$00,$00,$00
	.byte $00,$00,$00,$00,$00,$00,$00,$00
	.byte $00,$00,$00,$00,$00,$00,$00,$00
	.byte $00,$00,$00,$00,$00,$00,$00,$00
	.byte $00,$00,$00,$00,$00,$00,$00,$00

title2_left:
	.byte $00,$CD,$CD,$55,$55,$4D,$4D,$55
	.byte $55,$CD,$CD,$00,$00,$00,$00,$00
	.byte $00,$00,$00,$00,$00,$00,$00,$00
	.byte $00,$00,$00,$00,$00,$00,$00,$00
	.byte $00,$00,$14,$68,$00,$00,$00,$80
	.byte $00,$00,$00,$00,$00,$A4,$00,$00

title0_right:
	.byte $00,$50,$50,$D0,$D0,$50,$50,$50
	.byte $50,$50,$50,$00,$00,$00,$00,$00
	.byte $00,$00,$00,$00,$00,$00,$00,$00
	.byte $00,$00,$00,$00,$00,$00,$00,$00
	.byte $00,$00,$00,$20,$00,$00,$00,$20
	.byte $00,$00,$00,$00,$00,$80,$00,$00

.align $100

title1_right:
	.byte $00,$2C,$2C,$6A,$6A,$AC,$AC,$2A
	.byte $2A,$2C,$2C,$00,$00,$00,$00,$00
	.byte $00,$00,$00,$00,$00,$00,$00,$00
	.byte $00,$00,$00,$00,$00,$00,$00,$00
	.byte $00,$00,$00,$80,$00,$00,$00,$00
	.byte $00,$00,$00,$00,$00,$80,$00,$00

title2_right:
	.byte $00,$8B,$8B,$D9,$D9,$AB,$AB,$89
	.byte $89,$8B,$8B,$00,$00,$00,$00,$00
	.byte $00,$00,$00,$00,$00,$00,$00,$00
	.byte $00,$00,$00,$00,$00,$00,$00,$00
	.byte $00,$00,$00,$00,$00,$00,$00,$00
	.byte $00,$00,$00,$00,$00,$00,$00,$00
