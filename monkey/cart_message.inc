
cart_message0:
	.byte $1E	.****...
	.byte $20	.....*..
	.byte $20	.....*..
	.byte $20	.....*..
	.byte $20	.....*..
	.byte $20	.....*..
	.byte $1E	.****...
	.byte $00	........
	.byte $00	........
	.byte $00	........
	.byte $00	........
	.byte $00	........
	.byte $00	........
	.byte $00	........
	.byte $00	........
	.byte $79	*..****.
	.byte $82	.*.....*
	.byte $81	*......*
	.byte $80	.......*
	.byte $81	*......*
	.byte $80	.......*
	.byte $78	...****.
	.byte $00	........
	.byte $00	........
	.byte $00	........
	.byte $00	........
	.byte $00	........
	.byte $00	........
	.byte $00	........
	.byte $00	........

cart_message1:
	.byte $72	.*..***.
	.byte $8A	.*.*...*
	.byte $8A	.*.*...*
	.byte $8A	.*.*...*
	.byte $73	**..***.
	.byte $00	........
	.byte $00	........
	.byte $0F	****....
	.byte $08	...*....
	.byte $04	..*.....
	.byte $02	.*......
	.byte $09	*..*....
	.byte $06	.**.....
	.byte $00	........
	.byte $00	........
	.byte $E8	...*.***
	.byte $28	...*.*..
	.byte $E8	...*.***
	.byte $28	...*.*..
	.byte $CF	****..**
	.byte $00	........
	.byte $00	........
	.byte $00	........
	.byte $A2	.*...*.*
	.byte $A2	.*...*.*
	.byte $A2	.*...*.*
	.byte $A2	.*...*.*
	.byte $BC	..****.*
	.byte $80	.......*
	.byte $80	.......*

cart_message2:
	.byte $21	*....*..
	.byte $22	.*...*..
	.byte $22	.*...*..
	.byte $22	.*...*..
	.byte $CF	****..**
	.byte $02	.*......
	.byte $00	........
	.byte $78	...****.
	.byte $40	......*.
	.byte $20	.....*..
	.byte $10	....*...
	.byte $48	...*..*.
	.byte $30	....**..
	.byte $00	........
	.byte $00	........
	.byte $09	*..*....
	.byte $11	*...*...
	.byte $11	*...*...
	.byte $91	*...*..*
	.byte $3D	*.****..
	.byte $10	....*...
	.byte $00	........
	.byte $00	........
	.byte $F1	*...****
	.byte $0A	.*.*....
	.byte $73	**..***.
	.byte $82	.*.....*
	.byte $79	*..****.
	.byte $00	........
	.byte $00	........

cart_message3:
	.byte $28	...*.*..
	.byte $28	...*.*..
	.byte $28	...*.*..
	.byte $28	...*.*..
	.byte $8F	****...*
	.byte $20	.....*..
	.byte $00	........
	.byte $08	...*....
	.byte $11	*...*...
	.byte $11	*...*...
	.byte $11	*...*...
	.byte $7C	..*****.
	.byte $10	....*...
	.byte $00	........
	.byte $00	........
	.byte $04	..*.....
	.byte $05	*.*.....
	.byte $05	*.*.....
	.byte $14	..*.*...
	.byte $E0	.....***
	.byte $04	..*.....
	.byte $00	........
	.byte $00	........
	.byte $E4	..*..***
	.byte $04	..*.....
	.byte $C4	..*...**
	.byte $24	..*..*..
	.byte $C7	***...**
	.byte $00	........
	.byte $00	........

cart_message4:
	.byte $9E	.****..*
	.byte $A2	.*...*.*
	.byte $A2	.*...*.*
	.byte $A2	.*...*.*
	.byte $22	.*...*..
	.byte $00	........
	.byte $00	........
	.byte $E0	.....***
	.byte $10	....*...
	.byte $10	....*...
	.byte $10	....*...
	.byte $E0	.....***
	.byte $00	........
	.byte $03	**......
	.byte $00	........
	.byte $F3	**..****
	.byte $14	..*.*...
	.byte $14	..*.*...
	.byte $F3	**..****
	.byte $10	....*...
	.byte $10	....*...
	.byte $00	........
	.byte $00	........
	.byte $02	.*......
	.byte $04	..*.....
	.byte $04	..*.....
	.byte $44	..*...*.
	.byte $9F	*****..*
	.byte $04	..*.....
	.byte $00	........

cart_message5:
	.byte $78	...****.
	.byte $80	.......*
	.byte $F0	....****
	.byte $88	...*...*
	.byte $70	....***.
	.byte $00	........
	.byte $00	........
	.byte $00	........
	.byte $00	........
	.byte $00	........
	.byte $00	........
	.byte $00	........
	.byte $00	........
	.byte $80	.......*
	.byte $40	......*.
	.byte $CF	****..**
	.byte $50	....*.*.
	.byte $5E	.****.*.
	.byte $D1	*...*.**
	.byte $0E	.***....
	.byte $00	........
	.byte $00	........
	.byte $00	........
	.byte $00	........
	.byte $00	........
	.byte $00	........
	.byte $00	........
	.byte $00	........
	.byte $00	........
	.byte $00	........
