; Using background color $00
lookout_colors:
	.byte $02,$00,$02,$7E,$02,$7E,$02,$00
	.byte $02,$7E,$02,$00,$02,$A0,$02,$A0
	.byte $02,$A0,$0E,$A0,$02,$A0,$02,$A0
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	.byte $A0,$98,$A0,$A6,$A0,$A6,$A0,$A8


lookout_playfield0_left:
	.byte $00,$00,$00,$00,$00,$00,$00,$00
	.byte $00,$00,$00,$00,$00,$F0,$00,$F0
	.byte $00,$F0,$40,$F0,$00,$F0,$00,$F0
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	.byte $20,$10,$A0,$10,$A0,$10,$A0,$10

lookout_playfield1_left:
	.byte $00,$00,$00,$02,$00,$40,$00,$00
	.byte $00,$10,$00,$00,$00,$FF,$00,$FF
	.byte $00,$FF,$00,$FF,$00,$FF,$00,$FF
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	.byte $05,$00,$05,$00,$0A,$00,$0A,$00

.align $100

lookout_playfield2_left:
	.byte $00,$00,$00,$00,$00,$00,$00,$00
	.byte $00,$00,$00,$00,$00,$FF,$00,$FF
	.byte $00,$FF,$02,$FF,$00,$FF,$01,$FE
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	.byte $56,$00,$52,$00,$4A,$00,$4B,$00

lookout_playfield0_right:
	.byte $00,$00,$00,$00,$00,$00,$00,$00
	.byte $00,$00,$00,$00,$00,$F0,$00,$F0
	.byte $00,$F0,$00,$F0,$00,$F0,$00,$F0
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	.byte $E0,$00,$30,$00,$20,$00,$60,$00

lookout_playfield1_right:
	.byte $1D,$00,$24,$00,$1B,$00,$2B,$00
	.byte $6B,$00,$50,$00,$60,$8F,$00,$8F
	.byte $E0,$0F,$00,$8F,$E0,$0F,$00,$8F
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	.byte $73,$0C,$F3,$0C,$70,$0A,$85,$0A

.align $100

lookout_playfield2_right:
	.byte $0D,$00,$17,$00,$3C,$00,$72,$00
	.byte $8A,$00,$F8,$00,$28,$07,$D0,$0F
	.byte $E0,$0F,$01,$0F,$40,$03,$E0,$03
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	.byte $73,$0C,$8B,$14,$80,$14,$0B,$14

