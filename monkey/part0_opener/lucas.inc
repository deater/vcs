; Using background color $00
lucas_colors:
;	.byte $00,$00,$00,$00,$00,$00,$00,$00
;	.byte $00,$00,$00,$00,$00
	.byte $08,$4E,$4E
	.byte $4E,$4E,$4E,$4E,$4E,$4E,$4E,$4E
	.byte $4E,$4E,$4E,$08,$4E,$4E,$4E,$4E
	.byte $4E,$4E,$4E,$00,$00,$00,$00,$00
	.byte $00,$00,$00,$00,$00,$00,$00,$00


lucas_playfield0_left:
;	.byte $00,$00,$00,$00,$00,$00,$00,$00
;	.byte $00,$00,$00,$00,$00
	.byte $60,$60,$60
	.byte $60,$60,$60,$60,$60,$60,$60,$60
	.byte $60,$60,$60,$60,$60,$E0,$E0,$E0
	.byte $00,$00,$00,$00,$00,$00,$00,$00
	.byte $00,$00,$00,$00,$00,$00,$00,$00

lucas_playfield1_left:
;	.byte $00,$00,$00,$00,$00,$00,$00,$00
;	.byte $00,$00,$00,$00,$00
	.byte $A6,$AF,$A9
	.byte $A9,$A9,$A8,$A8,$A8,$A9,$A9,$EF
	.byte $46,$00,$00,$1F,$3F,$B3,$AF,$A9
	.byte $2D,$33,$1F,$00,$00,$00,$00,$00
	.byte $00,$00,$00,$00,$00,$00,$00,$00

lucas_playfield2_left:
;	.byte $00,$00,$00,$00,$00,$00,$00,$00
;	.byte $00,$00,$00,$00,$00
	.byte $CC,$CC,$CC
	.byte $4E,$5A,$D2,$D2,$1E,$5E,$52,$D2
	.byte $D2,$00,$00,$FF,$FF,$BB,$35,$35
	.byte $A0,$AE,$FF,$00,$00,$00,$00,$00
	.byte $00,$00,$00,$00,$00,$00,$00,$00

lucas_playfield0_right:
;	.byte $00,$00,$00,$00,$00,$00,$00,$00
;	.byte $00,$00,$00,$00,$00
	.byte $D0,$D0,$50
	.byte $50,$40,$40,$D0,$50,$50,$50,$50
	.byte $50,$00,$00,$F0,$F0,$B0,$90,$80
	.byte $A0,$B0,$F0,$00,$00,$00,$00,$00
	.byte $00,$00,$00,$00,$00,$00,$00,$00

;.align $100

lucas_playfield1_right:
;	.byte $00,$00,$00,$00,$00,$00,$00,$00
;	.byte $00,$00,$00,$00,$00
	.byte $D4,$D4,$14
	.byte $14,$14,$14,$94,$14,$14,$14,$14
	.byte $17,$00,$00,$FE,$FF,$11,$77,$19
	.byte $7D,$11,$FE,$00,$00,$00,$00,$00
	.byte $00,$00,$00,$00,$00,$00,$00,$00

lucas_playfield2_right:
;	.byte $00,$00,$00,$00,$00,$00,$00,$00
;	.byte $00,$00,$00,$00,$00
	.byte $42,$42,$66
	.byte $66,$66,$66,$66,$66,$7E,$7E,$5A
	.byte $5A,$5A,$5A,$5A,$5A,$5A,$5A,$42
	.byte $42,$00,$00,$00,$00,$00,$00,$00
	.byte $00,$00,$00,$00,$00,$00,$00,$00
