; Using background color $00
title_bg_colors:
	.byte $A0,$8C,$90,$90,$90,$90,$90,$90
	.byte $90,$90,$90,$84,$84,$84,$84,$84
	.byte $86,$86,$86,$96,$96,$96,$98,$A6
	.byte $90,$90,$90,$90,$90,$90,$90,$90
	.byte $90,$90,$90,$90,$00,$A0,$00,$A0
	.byte $A0,$A0,$A0,$A0,$A0,$A0,$A0,$A0

title_colors:
	.byte $9C,$A0,$0E,$F4,$F4,$00,$00,$00
	.byte $00,$00,$00,$00,$00,$00,$00,$00
	.byte $00,$00,$00,$00,$00,$00,$00,$00
	.byte $00,$00,$00,$00,$00,$00,$00,$00
	.byte $00,$00,$00,$00,$A0,$00,$A0,$00
	.byte $00,$00,$00,$00,$00,$00,$00,$00


title_playfield0_left:
	.byte $00,$E0,$80,$00,$00,$00,$00,$00
	.byte $00,$00,$00,$00,$00,$00,$00,$00
	.byte $00,$00,$00,$00,$00,$00,$00,$00
	.byte $00,$00,$00,$00,$00,$00,$00,$00
	.byte $00,$00,$80,$E0,$80,$00,$E0,$A0
	.byte $C0,$E0,$80,$00,$00,$00,$00,$00

title_playfield1_left:
	.byte $40,$F7,$01,$00,$00,$00,$00,$00
	.byte $00,$00,$00,$00,$00,$00,$00,$00
	.byte $00,$00,$01,$03,$07,$07,$07,$0F
	.byte $0F,$0F,$1F,$1F,$3F,$3F,$7F,$7F
	.byte $7F,$FF,$FF,$FF,$E0,$7F,$0B,$87
	.byte $B3,$DE,$F5,$7F,$41,$04,$02,$00

title_playfield2_left:
	.byte $10,$FF,$00,$80,$40,$F0,$F8,$F8
	.byte $F8,$F8,$F8,$F8,$FC,$FC,$FC,$FE
	.byte $FE,$FF,$FF,$FF,$FF,$FF,$FF,$FF
	.byte $FF,$FF,$FF,$FF,$FF,$FF,$FF,$FF
	.byte $FF,$FF,$FF,$FF,$04,$C7,$55,$6F
	.byte $6D,$53,$ED,$D7,$0F,$BF,$82,$00

