; Marker switches have to be 0...7 for code size reasons

LOCATION_GEAR_N		=	0
LOCATION_DENTIST_N	=	1
LOCATION_ROCKET_CLOSE_N	=	2
LOCATION_POOL_N		=	3
LOCATION_SHACK_W	=	4
LOCATION_CABIN_E	=	5
LOCATION_CLOCK_CLOSE_S	=	6
LOCATION_DOCK_N		=	7

; book destinations
LOCATION_RED_BOOK_CLOSE	=	8
LOCATION_BLUE_BOOK_CLOSE=	9
LOCATION_GREEN_BOOK_CLOSE=	10
LOCATION_ARRIVAL_N	=	11

LOCATION_CLOCK_S	=	12
LOCATION_ROCKET		=	13
LOCATION_HILLTOP_W	=	14
LOCATION_IMAGER_W	=	15
LOCATION_HILLTOP_S	=	16
LOCATION_HILLTOP_N	=	17
LOCATION_HILLTOP_E	=	18
LOCATION_ARRIVAL_E	=	19
LOCATION_CLOCK_N	=	20
LOCATION_SHORTSTEPS_W	=	21
LOCATION_LIBRARY_N	=	22
LOCATION_GEAR_S		=	23
LOCATION_LIBRARY_S	=	24
LOCATION_ARRIVAL_S	=	25
LOCATION_ARRIVAL_W	=	26
LOCATION_HILL_W		=	27
LOCATION_LIBRARY_W	=	28
LOCATION_LIBRARY_E	=	29
LOCATION_STEPS_S	=	30
LOCATION_SHACK_S	=	31
LOCATION_CABIN_PATH_S	=	32
LOCATION_CABIN_PATH_N	=	33
LOCATION_LIBRARY_SW	=	34
LOCATION_LIBRARY_SE	=	35
LOCATION_BURNT_BOOK	=	36
LOCATION_IMAGER_E	=	37
