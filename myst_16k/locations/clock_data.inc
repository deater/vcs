;===========================
; clock data
;===========================

clock_colors:
	.byte $0E
	.byte $0E
	.byte $0E
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	.byte $D6

clock_playfield0_left:
	.byte $40
	.byte $40
	.byte $40
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	.byte $00

clock_playfield1_left:
	.byte $58
	.byte $C8
	.byte $58
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	.byte $55

clock_playfield2_left:
	.byte $FE
	.byte $FC
	.byte $FC
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	.byte $AA

clock_playfield0_right:
	.byte $F0
	.byte $30
	.byte $10
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	.byte $A0

.align $100

clock_playfield1_right:
	.byte $01
	.byte $01
	.byte $01
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	.byte $54

clock_playfield2_right:
	.byte $00
	.byte $00
	.byte $00
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	.byte $00



clock_overlay_colors:
	.byte $04
	.byte $04
	.byte $04
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	.byte $E8

clock_overlay_sprite:
	.byte $03
	.byte $1C
	.byte $60
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	.byte $AA

