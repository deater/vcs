
title_playfield1_left:
	.byte $00,$7A,$7A,$42,$42,$72,$72,$42
	.byte $42,$43,$43,$00,$00,$00,$73,$7B
	.byte $4A,$4A,$73,$73,$52,$4A,$4B,$4B

title_playfield2_left:
	.byte $00,$30,$78,$48,$48,$48,$48,$48
	.byte $48,$7B,$33,$00,$00,$00,$73,$7B
	.byte $08,$08,$39,$71,$40,$40,$7B,$3B

title_playfield0_right:
	.byte $00,$70,$F0,$90,$90,$F0,$70,$10
	.byte $10,$10,$10,$00,$00,$00,$60,$F0
	.byte $90,$10,$10,$10,$10,$90,$F0,$60

title_playfield1_right:
	.byte $00,$72,$7A,$49,$49,$78,$70,$40
	.byte $40,$40,$40,$00,$00,$00,$4B,$4B
	.byte $4A,$4A,$4B,$4B,$4A,$4A,$7B,$33

title_playfield2_right:
	.byte $00,$04,$04,$02,$02,$01,$01,$01
	.byte $01,$01,$01,$00,$00,$00,$03,$03
	.byte $00,$00,$01,$01,$00,$00,$03,$03

.align $100


title_bitmap0:
	.byte $00
	.byte $00
	.byte $84
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	.byte $00

title_bitmap1:
	.byte $00
	.byte $00
	.byte $18
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	.byte $00


title_bitmap2:
	.byte $00
	.byte $00
	.byte $E6
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	.byte $00


.align $100


title_bitmap3:
	.byte $00
	.byte $00
	.byte $39
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	.byte $00

;.align $100


title_bitmap4:
	.byte $00
	.byte $00
	.byte $4C
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	.byte $00

title_bitmap5:
	.byte $00
	.byte $00
	.byte $96
	.byte $91
	.byte $92
	.byte $E4
	.byte $03
frame5_playfield2_right:
frame6_playfield2_right:
	.byte $00
	.byte $00
	.byte $00
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	.byte $00
frame3_playfield2_left:
	.byte $00
	.byte $00
	.byte $00
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	.byte $00
