.align $100
; Using background color $06

frame3_playfield2_left:
	.byte $00,$00,$00,$00,$00,$00,$00,$00
	.byte $00,$00,$00,$00,$00,$00,$00,$00
	.byte $00,$00,$00,$00,$00,$00,$00,$00
	.byte $00,$80,$80,$80,$80,$80,$80,$40
	.byte $60,$70,$78,$78,$78,$78,$78,$78
	.byte $78,$78,$78,$78,$78,$78,$78,$78

frame3_playfield0_right:
	.byte $00,$00,$00,$00,$00,$00,$00,$00
	.byte $00,$00,$00,$00,$00,$00,$00,$00
	.byte $00,$00,$00,$00,$00,$00,$00,$00
	.byte $00,$10,$90,$D0,$F0,$F0,$F0,$F0
	.byte $F0,$F0,$F0,$F0,$F0,$F0,$F0,$F0
	.byte $F0,$F0,$F0,$F0,$F0,$F0,$F0,$F0

frame3_playfield1_right:
	.byte $00,$00,$00,$00,$00,$00,$00,$00
	.byte $00,$00,$00,$00,$00,$00,$00,$00
	.byte $00,$00,$00,$00,$00,$00,$00,$00
	.byte $00,$00,$00,$80,$E0,$F0,$F8,$F8
	.byte $F8,$FC,$FC,$FC,$FC,$FC,$FC,$FC
	.byte $FC,$FE,$FE,$FE,$FE,$FE,$FF,$FF

frame3_playfield2_right:
	.byte $00,$00,$00,$00,$00,$00,$00,$00
	.byte $00,$00,$00,$00,$00,$00,$00,$00
	.byte $00,$00,$00,$00,$00,$00,$00,$00
	.byte $00,$00,$00,$00,$00,$00,$00,$00
	.byte $00,$00,$00,$00,$00,$00,$00,$00
	.byte $00,$00,$00,$00,$00,$00,$00,$00
; Using background color $00
frame3_1_overlay_colors:
	.byte $00,$00,$00,$00,$00,$00,$00,$00
	.byte $00,$00,$3A,$3A,$38,$F0,$F2,$F2
	.byte $F2,$F4,$46,$48,$48,$4A,$48,$48
	.byte $0A,$0A,$0A,$0A,$0A,$0A,$0A,$0A
	.byte $F0,$F0,$F0,$0A,$0A,$0A,$0A,$0A
	.byte $0A,$0A,$0A,$0A,$0A,$0A,$0A,$0A

.align $100

frame3_1_overlay_sprite:
	.byte $00,$00,$00,$00,$00,$00,$00,$00
	.byte $00,$00,$20,$20,$60,$70,$72,$62
	.byte $62,$6E,$2C,$70,$70,$26,$20,$2C
	.byte $18,$00,$00,$02,$02,$02,$02,$06
	.byte $60,$20,$20,$0C,$00,$0C,$00,$0C
	.byte $00,$0C,$00,$0C,$00,$0C,$00,$0C
; Using background color $00
frame3_2_overlay_colors:
	.byte $00,$00,$00,$00,$00,$00,$00,$00
	.byte $00,$00,$24,$24,$F2,$F2,$4A,$4A
	.byte $4A,$4A,$F2,$4A,$4A,$28,$4A,$46
	.byte $4A,$4A,$4A,$4A,$48,$48,$46,$46
	.byte $0A,$0A,$0A,$0A,$0A,$0A,$0A,$0A
	.byte $0A,$0A,$0A,$48,$48,$48,$48,$48


frame3_2_overlay_sprite:
	.byte $00,$00,$00,$00,$00,$00,$00,$00
	.byte $00,$00,$60,$70,$78,$38,$30,$70
	.byte $70,$40,$48,$38,$38,$60,$78,$40
	.byte $10,$10,$18,$10,$10,$10,$10,$20
	.byte $30,$30,$00,$00,$00,$00,$00,$00
	.byte $00,$00,$00,$08,$0C,$0C,$0E,$06

.align $100
