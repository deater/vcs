; Using background color $06


frame4_playfield2_left:
	.byte $00,$00,$00,$00,$00,$00,$00,$00
	.byte $00,$00,$00,$00,$00,$00,$00,$00
	.byte $00,$00,$00,$00,$00,$00,$00,$00
	.byte $80,$C0,$E0,$E0,$F0,$F8,$F8,$78
	.byte $78,$78,$78,$78,$78,$78,$78,$78
	.byte $78,$70,$70,$70,$70,$78,$78,$78

frame4_playfield0_right:
	.byte $00,$00,$00,$00,$00,$00,$00,$00
	.byte $00,$00,$00,$00,$00,$00,$00,$00
	.byte $00,$00,$00,$00,$00,$80,$C0,$C0
	.byte $D0,$F0,$F0,$F0,$F0,$F0,$F0,$F0
	.byte $F0,$F0,$F0,$F0,$F0,$F0,$F0,$F0
	.byte $F0,$F0,$F0,$F0,$F0,$F0,$F0,$F0


.align $100

frame4_playfield1_right:
	.byte $00,$00,$00,$00,$00,$00,$00,$00
	.byte $00,$00,$00,$00,$00,$00,$00,$00
	.byte $00,$00,$00,$00,$00,$00,$80,$E0
	.byte $F8,$F8,$F8,$FC,$FC,$FC,$FC,$FC
	.byte $FE,$FE,$FF,$FF,$FF,$FF,$FF,$FF
	.byte $FF,$FF,$FF,$FF,$FF,$FE,$F0,$F0

frame4_playfield2_right:
	.byte $00,$00,$00,$00,$00,$00,$00,$00
	.byte $00,$00,$00,$00,$00,$00,$00,$00
	.byte $00,$00,$00,$00,$00,$00,$00,$00
	.byte $00,$00,$00,$00,$00,$00,$00,$00
	.byte $00,$00,$00,$00,$01,$01,$01,$01
	.byte $01,$01,$01,$01,$01,$00,$00,$00
; Using background color $00
frame4_1_overlay_colors:
	.byte $00,$00,$00,$00,$38,$24,$24,$F2
	.byte $22,$24,$22,$F2,$F2,$48,$48,$48
	.byte $48,$46,$48,$4C,$24,$48,$0A,$0A
	.byte $0A,$0A,$0A,$0A,$0A,$0A,$0A,$0A
	.byte $0A,$0A,$0A,$0A,$48,$0A,$48,$0A
	.byte $E0,$0A,$0A,$0A,$0A,$0A,$0A,$0A


frame4_1_overlay_sprite:
	.byte $00,$00,$00,$00,$08,$18,$10,$13
	.byte $30,$31,$21,$31,$15,$3B,$38,$31
	.byte $18,$08,$18,$10,$1C,$1C,$02,$02
	.byte $1A,$26,$24,$24,$00,$04,$00,$0C
	.byte $00,$0C,$00,$08,$03,$08,$03,$08
	.byte $03,$08,$00,$08,$00,$08,$00,$08
; Using background color $00
frame4_2_overlay_colors:
	.byte $00,$00,$00,$00,$24,$F2,$F2,$F0
	.byte $F2,$4A,$48,$4A,$48,$4A,$4A,$4A
	.byte $4A,$48,$4A,$48,$4A,$4A,$48,$48
	.byte $48,$48,$48,$48,$48,$48,$48,$48
	.byte $48,$48,$48,$48,$48,$4A,$4A,$4A
	.byte $4A,$E0,$E0,$E0,$E0,$E0,$E0,$E0

.align $100

frame4_2_overlay_sprite:
	.byte $00,$00,$00,$00,$10,$18,$3C,$30
	.byte $3C,$38,$78,$38,$28,$10,$1C,$38
	.byte $18,$58,$18,$38,$08,$08,$70,$70
	.byte $10,$00,$00,$00,$00,$00,$00,$00
	.byte $00,$00,$00,$0C,$0E,$0E,$03,$0F
	.byte $03,$0F,$0F,$0F,$0F,$0F,$07,$07
