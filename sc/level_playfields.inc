; Playfield data

; note we currently ignore bottom 3 bytes

l1_playfield0_left:
l2_playfield0_left:	; same as l1_playfield0_left
l4_playfield0_left:	; same as l1_playfield0_left
	.byte	$F0,$10,$10,$10,$10,$10,$10,$10
	.byte	$10,$10,$10,$10,$10,$10,$10,$10
	.byte	$10,$10,$10,$10,$10,$10,$10,$10
	.byte	$10,$10,$10,$10,$10,$10,$10,$10
	.byte	$10,$10,$10;,$10,$10,$F0
l3_playfield0_left:
	.byte	$F0,$10,$10,$10,$10,$F0,$F0,$F0
	.byte	$F0,$10,$10,$10,$10,$10,$10,$10
	.byte	$10,$10,$10,$10,$10,$10,$10,$10
	.byte	$10,$10,$10,$10,$10,$F0,$F0,$F0
	.byte	$F0,$10,$10;,$10,$10,$F0

l2_playfield2_left:
	.byte	$FF,$00,$00,$00,$00,$F8,$F8,$F8
	.byte	$F8,$38,$38,$38,$38,$38,$38,$38
	.byte	$38,$38,$38,$38,$38,$38,$38,$38
	.byte	$38,$38,$38,$38,$38,$00,$00,$00
	.byte	$00,$00,$00;,$00,$00,$FF
l1_playfield1_left:
	.byte	$FF,$00,$00,$00,$00,$7f,$7f,$7f
	.byte	$7f,$18,$18,$18,$18,$18,$18,$18
	.byte	$18,$18,$18,$18,$18,$18,$18,$18
	.byte	$18,$18,$18,$18,$18,$7f,$7f,$7f
	.byte	$7f,$00,$00;,$00,$00,$FF
l1_playfield2_left:
	.byte	$FF,$00,$00,$00,$00,$1f,$1f,$1f
	.byte	$1f,$00,$00,$00,$00,$00,$fe,$fe
	.byte	$1e,$02,$02,$02,$02,$1e,$fe,$fe
	.byte	$00,$00,$00,$00,$00,$1f,$1f,$1f
	.byte	$1f,$00,$00;,$00,$00,$FF
.align $100
l2_playfield1_left:
	.byte	$FF,$00,$00,$00,$00,$30,$30,$30
	.byte	$30,$30,$30,$30,$30,$30,$30,$30
	.byte	$30,$30,$30,$30,$30,$30,$30,$30
	.byte	$30,$30,$30,$30,$30,$30,$30,$30
	.byte	$30,$00,$00;,$00,$00,$FF
l3_playfield1_left:
	.byte	$FF,$00,$00,$00,$00,$FE,$FE,$FE
	.byte	$FE,$18,$18,$18,$18,$18,$18,$18
	.byte	$0C,$0C,$0C,$0C,$0C,$0C,$0C,$0C
	.byte	$00,$00,$00,$00,$00,$FF,$FF,$FF
	.byte	$FF,$00,$00;,$00,$00,$FF

l3_playfield2_left:
	.byte	$FF,$00,$00,$00,$00,$00,$00,$00
	.byte	$00,$00,$00,$00,$00,$00,$FE,$FE
	.byte	$1E,$02,$02,$02,$02,$1E,$FE,$FE
	.byte	$00,$00,$00,$00,$00,$1F,$1F,$1F
	.byte	$1F,$00,$00;,$00,$00,$FF

l4_playfield1_left:
	.byte	$FF,$00,$00,$00,$00,$00,$00,$00
	.byte	$7f,$18,$18,$18,$18,$18,$18,$18
	.byte	$3F,$3F,$18,$18,$18,$18,$18,$18
	.byte	$18,$18,$18,$18,$18,$00,$00,$00
	.byte	$00,$00,$00;,$00,$00,$FF
l4_playfield2_left:
	.byte	$FF,$00,$00,$00,$FF,$FF,$FF,$FF
	.byte	$FF,$00,$AA,$54,$00,$00,$00,$00
	.byte	$70,$70,$00,$00,$00,$F0,$F0,$F0
	.byte	$F0,$F0,$F0,$F0,$F0,$F0,$F0,$F0
	.byte	$F0,$00,$00;,$00,$00,$FF
