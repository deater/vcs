colors:
	.byte $42
	.byte $42
	.byte $42
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	.byte $00

.if 0
text_colors:
	.byte $00
	.byte $80
	.byte $80
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	.byte $00
.endif

secret_playfield1_left:
	.byte $00
	.byte $06
	.byte $08
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	.byte $00

playfield2_left:
	.byte $C0
	.byte $C0
	.byte $E0
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	.byte $00

secret_playfield2_left:
	.byte $00
	.byte $67
	.byte $11
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	.byte $00

;.align $100

playfield0_right:
	.byte $10
	.byte $10
	.byte $30
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	.byte $00

secret_playfield0_right:
	.byte $00
	.byte $30
	.byte $50
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	.byte $00

playfield1_right:
	.byte $00
	.byte $00
	.byte $00
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	.byte $00

secret_playfield1_right:
	.byte $00
	.byte $EE
	.byte $84
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	.byte $00
